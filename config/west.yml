## config/west.yml
```yaml
manifest:
  remotes:
    - name: zmkfirmware
      url-base: https://github.com/zmkfirmware
    - name: petejohanson
      url-base: https://github.com/petejohanson
  projects:
    - name: zmk
      remote: petejohanson
      revision: boards-shields/fix-kscan-wakeup-source
      import: app/west.yml
    # - name: zmk
    #   remote: zmkfirmware
    #   revision: main
    #   import: app/west.yml
  self:
    path: config
```
